## drivers/misc/mediatek/connectivity/Kconfig
```kconfig
# SPDX-License-Identifier: GPL-2.0
config MTK_COMBO
bool "MediaTek MT6895 connectivity support"
help
  Enable the downstream MediaTek connectivity stack for MT6895
  (CONNAC2X2 SOC7_0) on the xaga mainline port.

config MTK_COMBO_CHIP_CONSYS_6895
bool "MT6895 Consys support"
depends on MTK_COMBO
default y

config MTK_COMBO_CHIP_CONSYS_6897
bool "MT6897 Consys support"
depends on MTK_COMBO
default y
help
  TB375FC (MT6897 / MT6898, CONNAC2X2 SOC7_0) consys platform.

config MTK_COMBO_WIFI_6897
bool "MT6897 Wi-Fi firmware flavour"
depends on MTK_COMBO_WIFI
default n
help
  Turn on when the device's connsys_wifi partition carries the MT6897
  (not MT6895) firmware build.  Selects the mediatek/mt6897/ firmware
  subdirectory in the fullmac driver.

config MTK_COMBO_WIFI
bool "MT6895 Wi-Fi support"
depends on MTK_COMBO
default y

config MTK_COMBO_BT
bool "MediaTek MT6895 Bluetooth HCI driver"
depends on MTK_COMBO && MTK_BTIF && BT
default y

config MTK_CONNSYS_DEDICATED_LOG_PATH
bool "MTK dedicated connsys log path"
depends on MTK_COMBO
default y
```
